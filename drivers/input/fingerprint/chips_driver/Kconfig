## drivers/input/fingerprint/chips_driver/Kconfig
```kconfig
config MTK_FINGERPRINT_CHIPSAILING_CS358
	bool "(chipsailing cs358 fingerprint sensor)  for chisailing"
	default n
	help
	It support different type sensor
	in this platform. If this option
	is set, it will support fingerprint cs358 sensor .
```

## drivers/misc/mediatek/aw9524/Kconfig
```kconfig
config MTK_AW9524
	tristate "MTK AW9524 Support"
	default n
	help
	  Say Y here if you have AW9524 Key device.

	  If unsure, say Y.
```

## drivers/misc/mediatek/sensors-1.0/magnetometer/af6133-new/Kconfig
```kconfig
config MTK_AF6133_NEW
	bool "AF6133 for MediaTek package"
	default n
	help
	  It support different magnetometer sensor.
          If this option is set,
	  it will support
          AF6133 magnetometer.
```

## drivers/misc/mediatek/sensors-1.0/magnetometer/af6133e-new/Kconfig
```kconfig
config MTK_AF6133E_NEW
	bool "AF6133E for MediaTek package"
	default n
	help
	  It support different magnetometer sensor.
          If this option is set,
	  it will support
          AF6133E magnetometer.
```
